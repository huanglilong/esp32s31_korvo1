## components/ulog/Kconfig.projbuild
```kconfig
menu "ULog Logger Configuration"

    config ULOG_ENABLE
        bool "Enable ULog file logging"
        default n
        help
            Enable writing uORB topics to SD card in ULog format.
            Logs are written to /sdcard/data/ (date or session based).

    if ULOG_ENABLE

        config ULOG_RINGBUF_SIZE
            int "Ring buffer size (bytes)"
            default 65536
            range 4096 262144
            help
                Size of the internal ring buffer for decoupling data
                collection from SD card writes. Larger buffers reduce
                the chance of data loss during burst writes.
                Default 64KB to accommodate camera frame topics (~8KB/frame).

        config ULOG_FLUSH_INTERVAL_MS
            int "File flush interval (ms)"
            default 100
            range 20 1000
            help
                How often to drain the ring buffer to the SD card file.
                Lower values reduce data loss risk but increase I/O overhead.

        config ULOG_SYNC_INTERVAL_MS
            int "Sync marker interval (ms)"
            default 500
            range 100 5000
            help
                How often to insert SYNC markers in the data section for
                crash recovery. Accepted by PX4 tools (Flight Review).

        config ULOG_FSYNC_INTERVAL_MS
            int "fsync interval (ms)"
            default 1000
            range 200 10000
            help
                How often to call fsync() to ensure data is written to
                the SD card. More frequent fsync reduces data loss on
                power failure but increases write latency.

        config ULOG_DEFAULT_INTERVAL_MS
            int "Default topic sampling interval (ms)"
            default 100
            range 10 5000
            help
                Default sampling interval for topics that don't specify
                their own interval.

        config ULOG_TASK_STACK_SIZE
            int "Writer task stack size (bytes)"
            default 8192
            range 2048 16384
            help
                Stack size for the ULog writer FreeRTOS task.
                Default 8KB: large data_buf for camera frames is heap-allocated.

        config ULOG_TASK_PRIORITY
            int "Writer task priority"
            default 5
            range 1 25
            help
                Priority of the ULog writer task. Higher = more CPU time
                for draining the buffer.

        config ULOG_MAX_CAPACITY_PCT
            int "Max ULog storage (% of SD card capacity)"
            default 70
            range 10 95
            help
                Maximum percentage of SD card total capacity allocated
                to .ulog files.  Oldest files are deleted to stay under
                this limit.  70% on a 16 GB card = ~11 GB for logs.

        config ULOG_MAX_FILE_SIZE
            int "Max single log file size (bytes)"
            default 104857600
            range 1048576 1073741824
            help
                Maximum size of a single .ulg file before rotation.
                When the current file reaches this size, it is closed
                and a new file is created in the same directory.
                Default: 100 MB (104857600 bytes).

        config ULOG_MIN_KEEP_FILES
            int "Minimum retained session files"
            default 200
            range 1 10000
            help
                Minimum number of .ulog files to keep, even if total
                size exceeds the capacity percentage.  Prevents wiping
                all data in a runaway high-rate logging scenario.

    endif

endmenu
```

## main/Kconfig.projbuild
```kconfig
menu "ESP32-S31 Korvo-1 Configuration"

    config APP_BROOKESIA_BUILD
        bool "Compile ESP-Brookesia integration"
        default y
        help
            Compile the ESP-Brookesia master/v0.8 integration layer.
            Hardware ownership remains with the legacy application until
            APP_BROOKESIA_ENABLE is explicitly enabled.

    config APP_BROOKESIA_ENABLE
        bool "Enable ESP-Brookesia runtime"
        default n
        depends on APP_BROOKESIA_BUILD
        help
            Start ESP-Brookesia runtime and migrate hardware ownership.
            Keep disabled while the staged migration is being validated.

    config EXAMPLE_SDMMC_BUS_WIDTH_4
        bool "SDMMC 4-line mode"
        default y
    choice EXAMPLE_SDMMC_SPEED_MODE
        prompt "SD/MMC speed mode"
        default EXAMPLE_SDMMC_SPEED_DS
        config EXAMPLE_SDMMC_SPEED_DS
            bool "Default Speed"
        config EXAMPLE_SDMMC_SPEED_HS
            bool "High Speed"
    endchoice

    config EXAMPLE_PIN_CLK
        int "SDMMC CLK pin"
        default 24
    config EXAMPLE_PIN_CMD
        int "SDMMC CMD pin"
        default 25
    config EXAMPLE_PIN_D0
        int "SDMMC D0 pin"
        default 20
    config EXAMPLE_PIN_D1
        int "SDMMC D1 pin"
        default 21
    config EXAMPLE_PIN_D2
        int "SDMMC D2 pin"
        default 22
    config EXAMPLE_PIN_D3
        int "SDMMC D3 pin"
        default 23

    # Audio
    config EXAMPLE_VOICE_VOLUME
        int "Speaker output volume"
        default 80
        range 0 100
    config EXAMPLE_I2C_SCL_IO
        int "I2C SCL GPIO"
        default 1
    config EXAMPLE_I2C_SDA_IO
        int "I2C SDA GPIO"
        default 0
    config EXAMPLE_I2S_MCLK_IO
        int "I2S MCLK GPIO"
        default 42
    config EXAMPLE_I2S_BCLK_IO
        int "I2S BCLK GPIO"
        default 3
    config EXAMPLE_I2S_WS_IO
        int "I2S WS GPIO"
        default 4
    config EXAMPLE_I2S_DOUT_IO
        int "I2S DOUT GPIO"
        default 5
    config EXAMPLE_I2S_DIN_IO
        int "I2S DIN GPIO"
        default 6

    # Camera DVP
    config EXAMPLE_CAMERA_XCLK_FREQ
        int "DVP XCLK Frequency (Hz)"
        default 20000000
        range 10000000 40000000
        help
            Master clock frequency output to the DVP camera sensor.
            Typical values: 20 MHz for OV3660.
    config EXAMPLE_CAMERA_XCLK_IO
        int "DVP XCLK GPIO"
        default 55
    config EXAMPLE_CAMERA_PCLK_IO
        int "DVP PCLK GPIO"
        default 54
    config EXAMPLE_CAMERA_HSYNC_IO
        int "DVP HSYNC GPIO"
        default 57
    config EXAMPLE_CAMERA_VSYNC_IO
        int "DVP VSYNC GPIO"
        default 56
    config EXAMPLE_CAMERA_D0_IO
        int "DVP D0 GPIO"
        default 46
    config EXAMPLE_CAMERA_D1_IO
        int "DVP D1 GPIO"
        default 47
    config EXAMPLE_CAMERA_D2_IO
        int "DVP D2 GPIO"
        default 48
    config EXAMPLE_CAMERA_D3_IO
        int "DVP D3 GPIO"
        default 49
    config EXAMPLE_CAMERA_D4_IO
        int "DVP D4 GPIO"
        default 50
    config EXAMPLE_CAMERA_D5_IO
        int "DVP D5 GPIO"
        default 51
    config EXAMPLE_CAMERA_D6_IO
        int "DVP D6 GPIO"
        default 52
    config EXAMPLE_CAMERA_D7_IO
        int "DVP D7 GPIO"
        default 53

    # ── App Logger (SD card text log) ──
    choice APP_LOG_SD_LEVEL
        prompt "Minimum log level for SD card"
        default APP_LOG_SD_LEVEL_INFO
        config APP_LOG_SD_LEVEL_NONE
            bool "None"
        config APP_LOG_SD_LEVEL_ERROR
            bool "Error"
        config APP_LOG_SD_LEVEL_WARN
            bool "Warning"
        config APP_LOG_SD_LEVEL_INFO
            bool "Info"
        config APP_LOG_SD_LEVEL_DEBUG
            bool "Debug"
    endchoice

    config APP_LOG_SD_LEVEL
        int
        default 0 if APP_LOG_SD_LEVEL_NONE
        default 1 if APP_LOG_SD_LEVEL_ERROR
        default 2 if APP_LOG_SD_LEVEL_WARN
        default 3 if APP_LOG_SD_LEVEL_INFO
        default 4 if APP_LOG_SD_LEVEL_DEBUG

    config APP_LOG_MAX_FILE_SIZE_KB
        int "Max log file size (KB)"
        default 1024
        range 64 10240
        help
            When the current log file reaches this size it is
            closed and a new file is created.

    config APP_LOG_MAX_FILES
        int "Max retained log files"
        default 5
        range 1 100
        help
            Maximum number of log files to retain on the SD card.
            Older files are deleted when this limit is exceeded.

    config APP_LOG_RINGBUF_SIZE
        int "Ring buffer size (bytes)"
        default 8192
        range 2048 65536
        help
            Internal ring buffer for decoupling log producers from
            SD card writes.  Larger = less producer blocking, but
            more RAM.

    # ── System Performance Monitor ──
    config APP_SYS_MONITOR_INTERVAL_MS
        int "System monitor sampling interval (ms)"
        default 5000
        range 1000 60000
        help
            How often the SystemMonitor samples FreeRTOS task CPU
            usage and heap memory. Shorter intervals give finer
            granularity but consume more CPU.

    config APP_SYS_MONITOR_LOG_INTERVAL
        int "Log summary every N samples"
        default 12
        range 0 3600
        help
            Print a human-readable system stats summary via ESP_LOGI
            every N sampling cycles. Set to 0 to disable periodic
            logging (stats are still available via uORB / HTTP API).

    config APP_SYS_MONITOR_TASK_STACK
        int "Monitor task stack size (bytes)"
        default 4096
        range 2048 8192
        help
            Stack size for the background system monitor task.

    config APP_SYS_MONITOR_CPU_ALERT_PCT
        int "CPU usage alert threshold (%)"
        default 90
        range 50 99
        help
            Fire a CPU_HIGH alert when total CPU usage exceeds this
            percentage. The alert includes the top CPU-consuming task.
            Set to 100 to disable CPU alerts.

    config APP_SYS_MONITOR_MEM_ALERT_PCT
        int "Memory usage alert threshold (%)"
        default 85
        range 50 99
        help
            Fire a MEM_HIGH alert when internal SRAM or PSRAM usage
            exceeds this percentage. Set to 100 to disable memory
            alerts.

    config APP_SYS_MONITOR_ALERT_COOLDOWN_S
        int "Alert cooldown period (seconds)"
        default 10
        range 5 3600
        help
            Minimum time between repeated alerts of the same type.
            Prevents alert flooding when a resource is persistently
            over threshold.

    # ── SNTP Configuration ──
    config SNTP_SERVER_0
        string "NTP server hostname"
        default "pool.ntp.org"
        help
            Primary NTP server for time synchronization. SNTP starts
            automatically after WiFi STA connects. The default
            pool.ntp.org works globally.

    config SNTP_DEFAULT_TIMEZONE
        string "Default timezone (POSIX TZ format)"
        default "CST-8"
        help
            Default timezone applied at boot before any web API
            overrides. Examples: UTC0 (UTC), CST-8 (China Standard
            Time), EST5EDT (US Eastern), JST-9 (Japan).

endmenu
```
