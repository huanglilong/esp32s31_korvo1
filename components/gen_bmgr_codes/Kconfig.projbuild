## sdkconfig.defaults
```kconfig
CONFIG_IDF_TARGET="esp32s31"
CONFIG_ESPTOOLPY_FLASHMODE_QIO=y
CONFIG_ESPTOOLPY_FLASHSIZE_16MB=y
CONFIG_PARTITION_TABLE_CUSTOM=y
CONFIG_PARTITION_TABLE_CUSTOM_FILENAME="partitions.csv"
CONFIG_PARTITION_TABLE_OFFSET=0x9000
CONFIG_COMPILER_OPTIMIZATION_PERF=y
CONFIG_SPIRAM=y
CONFIG_SPIRAM_MODE_OCT=y
CONFIG_SPIRAM_SPEED_200M=y
# PSRAM XIP: ESP32-S31 supports XIP (execute-in-place from PSRAM).
# Enabling SPIRAM_XIP_FROM_PSRAM moves Flash instructions+rodata to PSRAM,
# freeing IRAM and allowing code to run during Flash operations.
# Trade-off: increases PSRAM bus load. Our 200MHz OCT PSRAM has enough bandwidth.
# Official BSP example has these configs (via XIP select).
# Not enabled for now — can be enabled if IRAM pressure or Flash-op stalls occur.
CONFIG_SPIRAM_XIP_FROM_PSRAM=y
CONFIG_ESP_MAIN_TASK_STACK_SIZE=6144
# Reduce mDNS task stack (4KB → 3KB)
CONFIG_MDNS_TASK_STACK_SIZE=3072
CONFIG_FREERTOS_HZ=1000
CONFIG_FREERTOS_VTASKLIST_INCLUDE_COREID=y
CONFIG_FREERTOS_GENERATE_RUN_TIME_STATS=y
CONFIG_FREERTOS_USE_TRACE_FACILITY=y
CONFIG_ESP_DEFAULT_CPU_FREQ_MHZ_320=y
CONFIG_ESP_DEFAULT_CPU_FREQ_MHZ=320

# SNTP — sync wall-clock time after WiFi connects (needed for ULog date-based naming)
CONFIG_LWIP_SNTP_MAX_SERVERS=1
CONFIG_LWIP_SNTP_UPDATE_DELAY=3600000
CONFIG_LWIP_SNTP_STARTUP_DELAY=y
CONFIG_LWIP_SNTP_MAXIMUM_STARTUP_DELAY=5000
CONFIG_SNTP_SERVER_0="pool.ntp.org"
CONFIG_SNTP_DEFAULT_TIMEZONE="CST-8"

# FATFS
CONFIG_FATFS_VFS_FSTAT_BLKSIZE=4096

# Increase VFS table size — SD card (fatfs) + more entries
CONFIG_VFS_MAX_COUNT=16

# ESP32-S31 BSP configuration (espressif/esp32_s31_korvo_1 v1.0.0~1)
# Note: BSP uses CONFIG_BSP_ prefix for its Kconfig options
# BSP_I2S_SAMPLE_RATE, BSP_LCD_H_RES, BSP_LCD_V_RES are not exposed by the BSP component
# Display LVGL config
CONFIG_BSP_LCD_DRAW_BUF_HEIGHT=80
CONFIG_BSP_LCD_RGB_BUFFER_NUMS=2
CONFIG_BSP_DISPLAY_LVGL_AVOID_TEAR=y
# LED RGB backend (uses RMT for WS2812)
CONFIG_BSP_LED_RGB_BACKEND_RMT=y
# SPIFFS for internal storage
CONFIG_BSP_SPIFFS_MOUNT_POINT="/spiffs"
CONFIG_BSP_SPIFFS_PARTITION_LABEL="storage"
CONFIG_BSP_SPIFFS_MAX_FILES=5

# Audio I2S and I2C pins (TBD - will be updated when pin mapping is confirmed)
CONFIG_EXAMPLE_VOICE_VOLUME=80
CONFIG_EXAMPLE_I2C_SCL_IO=1
CONFIG_EXAMPLE_I2C_SDA_IO=0
CONFIG_EXAMPLE_I2S_MCLK_IO=-1
CONFIG_EXAMPLE_I2S_BCLK_IO=3
CONFIG_EXAMPLE_I2S_WS_IO=4
CONFIG_EXAMPLE_I2S_DOUT_IO=5
CONFIG_EXAMPLE_I2S_DIN_IO=6

# WiFi - STA reconnect and retry are handled at application level in IDF v6.x
# Brookesia WiFi service handles all WiFi init/start/connect internally.
# SoftAP provisioning is managed by Brookesia's SoftAp HAL adaptor.
CONFIG_BROOKESIA_SERVICE_WIFI_ENABLE_AUTO_REGISTER=y
CONFIG_BROOKESIA_SERVICE_WIFI_ENABLE_AUTO_LOAD_DATA=y
CONFIG_BROOKESIA_SERVICE_WIFI_CONNECT_RETRIES_MAX=10
CONFIG_BROOKESIA_SERVICE_WIFI_AUTO_CONNECT_DELAY_MS=5000
CONFIG_BROOKESIA_HAL_ADAPTOR_WIFI_SOFTAP_CHANNEL_DEFAULT=1

# LWIP TCP — reduced for internal SRAM savings
# TCP snd_buf/wnd 32KB→16KB: web config server only handles small JSON, 16KB is plenty.
# Each active TCP connection allocates snd_buf from internal heap; reducing saves ~16KB per conn.
CONFIG_LWIP_TCPIP_RECVMBOX_SIZE=32
CONFIG_LWIP_TCP_SND_BUF_DEFAULT=16384
CONFIG_LWIP_TCP_WND_DEFAULT=16384
CONFIG_LWIP_TCP_RECVMBOX_SIZE=32
# Max sockets/connections reduced: 28 sockets is overkill for an embedded device.
# 16 sockets, 16 active TCP, 8 listening TCP is sufficient for STA+AP + HTTP server.
CONFIG_LWIP_MAX_SOCKETS=16
CONFIG_LWIP_MAX_ACTIVE_TCP=16
CONFIG_LWIP_MAX_LISTENING_TCP=8

# HTTP Server
CONFIG_HTTPD_MAX_REQ_HDR_LEN=1024
CONFIG_HTTPD_MAX_URI_LEN=512
CONFIG_HTTPD_ERR_RESP_NO_DELAY=y

# mDNS — allow PSRAM allocation to save internal SRAM (~5 KB)
CONFIG_MDNS_MAX_SERVICES=8
CONFIG_MDNS_TASK_CREATE_FROM_SPIRAM=y
CONFIG_MDNS_MEMORY_ALLOC_SPIRAM=y

# ULog
CONFIG_ULOG_ENABLE=y

# Audio Codec (ES8389 via esp_codec_dev)
CONFIG_CODEC_ES8389_SUPPORT=y
# Use new i2c_master driver (IDF v5.3+), matching BSP's i2c_new_master_bus() API
CONFIG_CODEC_I2C_BACKWARD_COMPATIBLE=n

# Audio Simple Player resample dest rate — 16kHz per BSP recommendation
CONFIG_AUDIO_SIMPLE_PLAYER_RESAMPLE_DEST_RATE=16000

# LVGL filesystem drive letters required by ESP-Brookesia GUI components
CONFIG_LV_FS_STDIO_LETTER=65
CONFIG_LV_FS_POSIX_LETTER=65
CONFIG_LV_FS_DEFAULT_DRIVER_LETTER=65

# Channel converter: required for mono→stereo conversion.
# Without this, mono MP3 files play at 2x speed because the I2S codec
# is configured for stereo but receives mono data (each sample consumed
# as half a stereo frame, doubling the effective sample rate).
CONFIG_ESP_AUDIO_SIMPLE_PLAYER_CH_CVT_EN=y
CONFIG_AUDIO_SIMPLE_PLAYER_CH_CVT_DEST=2
# Bit converter: ensures 16-bit output matches codec configuration.
CONFIG_ESP_AUDIO_SIMPLE_PLAYER_BIT_CVT_EN=y
CONFIG_AUDIO_SIMPLE_PLAYER_BIT_CVT_DEST_16BIT=y

# Camera (DVP OV3660) - sensor driver + auto-detect
CONFIG_CAMERA_OV3660=y
CONFIG_CAMERA_OV3660_AUTO_DETECT_DVP_INTERFACE_SENSOR=y
CONFIG_CAMERA_OV3660_DVP_RGB565_BE_640X480_10FPS=y
CONFIG_CAMERA_OV3660_DVP_DEFAULT_FMT_RGB565_BE_640X480_10FPS=y

# PPA hardware acceleration is used directly by CameraApp (not via LVGL port)
# LVGL_PORT_ENABLE_PPA is P4-only (lcd_ppa.c relies on CONFIG_CACHE_L2_CACHE_LINE_SIZE)
# CONFIG_LVGL_PORT_ENABLE_PPA is not set

# LVGL SW rendering with RISC-V Vector asm optimizations
CONFIG_LV_DRAW_SW_ASM_RISCV_V=y

# Allocate WiFi/LWIP from PSRAM to save SRAM
CONFIG_SPIRAM_TRY_ALLOCATE_WIFI_LWIP=y
# P0: WiFi buffer optimization — reduce static buffers to save internal SRAM
# Static RX/TX buffers are always in internal SRAM; reducing count frees SRAM directly.
# Cache TX 16→8: further 12.5 KB saving; 8 is sufficient for STA+AP with modest traffic.
# Dynamic RX must be >= RX_BA_WIN (16); keep at 16 to avoid compile error.
CONFIG_ESP32_WIFI_STATIC_RX_BUFFER_NUM=8
CONFIG_ESP32_WIFI_STATIC_TX_BUFFER_NUM=8
CONFIG_ESP32_WIFI_CACHE_TX_BUFFER_NUM=8
CONFIG_ESP32_WIFI_DYNAMIC_RX_BUFFER_NUM=16
# Note: Dynamic TX buffers (type=1) are disabled by Kconfig when
# SPIRAM_TRY_ALLOCATE_WIFI_LWIP=y and SPIRAM_IGNORE_NOTFOUND is not set.
# The IDF prevents this combination to avoid PSRAM allocation issues with TX buffers.
# Keeping static TX buffers (type=0) is the safe choice with PSRAM WiFi/LWIP.
# P2a: Disable Ethernet — Korvo-1 has no EMAC PHY, saves ~15 KB SRAM + ~30 KB Flash
CONFIG_ETH_USE_ESP32_EMAC=n
CONFIG_ETH_USE_SPI_ETHERNET=n
# P2b: Disable IEEE 802.15.4 (Zigbee/Thread) — not used on Korvo-1, saves ~5 KB SRAM
CONFIG_IEEE802154_ENABLED=n
# P2c: MbedTLS optimization — reduce SRAM/Flash footprint
# SSL input buffer 16KB→4KB: our HTTP client only receives small JSON responses
CONFIG_MBEDTLS_SSL_IN_CONTENT_LEN=4096
# Reduce certificate bundle from 200→128: saves ~15 KB Flash (cacrt_all.pem has 121 certs)
CONFIG_MBEDTLS_CERTIFICATE_BUNDLE_MAX_CERTS=128
# Disable unused TLS features to save Flash/SRAM
CONFIG_MBEDTLS_SSL_RENEGOTIATION=n
CONFIG_MBEDTLS_SSL_ALL_ALERT_MESSAGES=n
CONFIG_MBEDTLS_SELF_TEST=n
CONFIG_MBEDTLS_ERROR_STRINGS=n
# Disable unused cipher modes (keep GCM for TLS 1.2, CTR for AES-CTR;
# XTS needed for flash encryption, keep it; CBC needed by wpa_supplicant for WiFi)
CONFIG_MBEDTLS_CIPHER_MODE_CFB=n
CONFIG_MBEDTLS_CIPHER_MODE_OFB=n
# P3: Disable Unity test framework in production build, saves ~3 KB
CONFIG_UNITY_ENABLE_FLOAT=n
CONFIG_UNITY_ENABLE_DOUBLE=n
CONFIG_UNITY_ENABLE_IDF_TEST_RUNNER=n

# Move event loop data to PSRAM
CONFIG_ESP_EVENT_LOOP_IN_EXT_RAM=y
# System monitor task stack (4KB → 2KB) — lightweight sampling task
CONFIG_APP_SYS_MONITOR_TASK_STACK=2048
# System event task stack must be ≥ 3072 for Brookesia WiFi HAL
CONFIG_ESP_SYSTEM_EVENT_TASK_STACK_SIZE=3072
# Push most heap allocations to PSRAM (only allocations ≤ 256 bytes stay in internal SRAM)
# This is the single most impactful config for internal SRAM pressure.
# At 4096, almost all malloc() calls went to internal SRAM, consuming 299 KB quickly.
# At 512, internal SRAM was still at 86% (38 KB free of 283 KB).
# At 256, more allocations go to PSRAM — only small structs stay in internal SRAM.
# Risk: some DMA-capable allocations >256B may land in PSRAM; if they crash,
# increase back to 512 and use heap_caps_malloc(MALLOC_CAP_DMA) for those.
CONFIG_SPIRAM_MALLOC_ALWAYSINTERNAL=256
# Reduce reserve pool for DMA/internal allocations from 16KB to 8KB
# since our main DMA users (I2S, SDMMC, Camera) use PSRAM-allocated buffers
# with PSRAM DMA capability (CONFIG_SOC_PSRAM_DMA_CAPABLE=y),
# and WiFi/LWIP is already in PSRAM.
CONFIG_SPIRAM_MALLOC_RESERVE_INTERNAL=8192

# --- Board-specific configuration (from esp_board_manager board_manager.defaults) ---
# Board: esp32_s31_korvo1
CONFIG_ESP_BOARD_ESP32_S31_KORVO1=y
CONFIG_ESP_BOARD_NAME="esp32_s31_korvo1"

CONFIG_ESP_BOARD_PERIPH_ADC_SUPPORT=y
CONFIG_ESP_BOARD_PERIPH_GPIO_SUPPORT=y
CONFIG_ESP_BOARD_PERIPH_I2C_SUPPORT=y
CONFIG_ESP_BOARD_PERIPH_I2S_SUPPORT=y
CONFIG_ESP_BOARD_DEV_AUDIO_CODEC_SUPPORT=y
CONFIG_ESP_BOARD_DEV_BUTTON_SUPPORT=y
CONFIG_ESP_BOARD_DEV_CAMERA_SUPPORT=y
CONFIG_ESP_BOARD_DEV_DISPLAY_LCD_SUPPORT=y
CONFIG_ESP_BOARD_DEV_FS_FAT_SUPPORT=y
CONFIG_ESP_BOARD_DEV_LCD_TOUCH_SUPPORT=y
CONFIG_ESP_BOARD_DEV_LED_STRIP_SUPPORT=y
CONFIG_ESP_BOARD_DEV_POWER_CTRL_SUPPORT=y
CONFIG_ESP_BOARD_DEV_BUTTON_SUB_ADC_MULTI_SUPPORT=y
CONFIG_ESP_BOARD_DEV_CAMERA_SUB_DVP_SUPPORT=y
CONFIG_ESP_BOARD_DEV_DISPLAY_LCD_SUB_RGB_SUPPORT=y
CONFIG_ESP_BOARD_DEV_FS_FAT_SUB_SDMMC_SUPPORT=y
CONFIG_ESP_BOARD_DEV_LCD_TOUCH_SUB_I2C_SUPPORT=y
CONFIG_ESP_BOARD_DEV_LCD_TOUCH_I2C_SUPPORT=y
CONFIG_ESP_BOARD_DEV_LED_STRIP_SUB_RMT_SUPPORT=y
CONFIG_ESP_BOARD_DEV_POWER_CTRL_SUB_GPIO_SUPPORT=y
CONFIG_APP_BROOKESIA_ENABLE=y
# --- ESP-Brookesia HAL Adaptor configuration (for APP_BROOKESIA_ENABLE=y) ---
# Only Display enabled for now. Audio/Video/Storage/WiFi added as needed.
CONFIG_BROOKESIA_HAL_ADAPTOR_ENABLE_DISPLAY_DEVICE=y
CONFIG_BROOKESIA_HAL_ADAPTOR_DISPLAY_ENABLE_LCD_PANEL_IMPL=y
CONFIG_BROOKESIA_HAL_ADAPTOR_DISPLAY_LCD_PANEL_H_RES=800
CONFIG_BROOKESIA_HAL_ADAPTOR_DISPLAY_LCD_PANEL_V_RES=480
CONFIG_BROOKESIA_HAL_ADAPTOR_DISPLAY_ENABLE_LCD_TOUCH_IMPL=y

# Audio
CONFIG_BROOKESIA_HAL_ADAPTOR_ENABLE_AUDIO_DEVICE=y
CONFIG_BROOKESIA_HAL_ADAPTOR_AUDIO_ENABLE_CODEC_PLAYER_IMPL=y
CONFIG_BROOKESIA_HAL_ADAPTOR_AUDIO_ENABLE_CODEC_RECORDER_IMPL=y
CONFIG_BROOKESIA_HAL_ADAPTOR_AUDIO_CODEC_RECORDER_BITS=32
CONFIG_BROOKESIA_HAL_ADAPTOR_AUDIO_CODEC_RECORDER_CHANNELS=2
CONFIG_BROOKESIA_HAL_ADAPTOR_AUDIO_CODEC_RECORDER_SAMPLE_RATE=16000
CONFIG_BROOKESIA_HAL_ADAPTOR_AUDIO_CODEC_RECORDER_MIC_LAYOUT="RMNN"
CONFIG_BROOKESIA_HAL_ADAPTOR_AUDIO_CODEC_RECORDER_GENERAL_GAIN="20.0"


# Video (Camera)
CONFIG_BROOKESIA_HAL_ADAPTOR_ENABLE_VIDEO_DEVICE=y
CONFIG_BROOKESIA_HAL_ADAPTOR_VIDEO_ENABLE_CAMERA_IMPL=y
CONFIG_ESP_VIDEO_ENABLE_DVP_VIDEO_DEVICE=y
CONFIG_ESP_VIDEO_ENABLE_SWAP_BYTE=y
CONFIG_ESP_VIDEO_ENABLE_SWAP_BYTE_RISCV=y

CONFIG_BROOKESIA_HAL_ADAPTOR_AUDIO_ENABLE_PROCESSOR_IMPL=n

# Disable video encoder/decoder (need av_processor which is not available)
CONFIG_BROOKESIA_HAL_ADAPTOR_VIDEO_ENABLE_ENCODER_IMPL=n
CONFIG_BROOKESIA_HAL_ADAPTOR_VIDEO_ENABLE_DECODER_IMPL=n
CONFIG_BROOKESIA_SERVICE_VIDEO_ENABLE_ENCODER=n
CONFIG_BROOKESIA_SERVICE_VIDEO_ENABLE_DECODER=n

# Storage (SD card + KV)
CONFIG_BROOKESIA_HAL_ADAPTOR_ENABLE_STORAGE_DEVICE=y
CONFIG_BROOKESIA_HAL_ADAPTOR_STORAGE_ENABLE_KEY_VALUE_IMPL=y
CONFIG_BROOKESIA_HAL_ADAPTOR_STORAGE_ENABLE_FILE_SYSTEM_IMPL=y
CONFIG_BROOKESIA_HAL_ADAPTOR_STORAGE_FILE_SYSTEM_ENABLE_SDCARD=y
CONFIG_NVS_ALLOCATE_CACHE_IN_SPIRAM=y

# Network (SNTP + HTTP)
CONFIG_BROOKESIA_HAL_ADAPTOR_ENABLE_NETWORK_DEVICE=y
CONFIG_BROOKESIA_HAL_ADAPTOR_NETWORK_ENABLE_SNTP_CLIENT_IMPL=y
CONFIG_BROOKESIA_HAL_ADAPTOR_NETWORK_ENABLE_HTTP_CLIENT_IMPL=y
CONFIG_LWIP_SNTP_MAX_SERVERS=4
CONFIG_LWIP_SNTP_STARTUP_DELAY=n
CONFIG_LWIP_DHCP_GET_NTP_SRV=y
CONFIG_LWIP_DHCP_MAX_NTP_SERVERS=4
# System (BoardInfo)
CONFIG_BROOKESIA_HAL_ADAPTOR_ENABLE_SYSTEM_DEVICE=y
CONFIG_BROOKESIA_HAL_ADAPTOR_SYSTEM_ENABLE_BOARD_INFO_IMPL=y
# WiFi
CONFIG_BROOKESIA_HAL_ADAPTOR_ENABLE_WIFI_DEVICE=y
```
